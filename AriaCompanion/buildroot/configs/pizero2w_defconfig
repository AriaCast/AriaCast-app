## AriaCompanion/buildroot/configs/pizero2w_defconfig
```kconfig
# AriaCompanion — Raspberry Pi Zero 2W (BCM2710/BCM2837, Cortex-A53, ARMv8, 64-bit)

# ── Architecture ──────────────────────────────────────────────────────────────
BR2_aarch64=y

# ── Toolchain ─────────────────────────────────────────────────────────────────
BR2_TOOLCHAIN_BUILDROOT_GLIBC=y
BR2_TOOLCHAIN_BUILDROOT_CXX=y

# ── System ────────────────────────────────────────────────────────────────────
BR2_TARGET_GENERIC_HOSTNAME="AriaCompanion"
BR2_TARGET_GENERIC_ISSUE="AriaCompanion"
BR2_TARGET_GENERIC_ROOT_PASSWD="aria"
BR2_INIT_BUSYBOX=y
BR2_SYSTEM_BIN_SH_BASH=y

# ── Kernel — Raspberry Pi fork, 6.6.y LTS ────────────────────────────────────
BR2_LINUX_KERNEL=y
BR2_LINUX_KERNEL_CUSTOM_GIT=y
BR2_LINUX_KERNEL_CUSTOM_REPO_URL="https://github.com/raspberrypi/linux"
BR2_LINUX_KERNEL_CUSTOM_REPO_VERSION="rpi-6.6.y"
BR2_LINUX_KERNEL_DEFCONFIG="bcm2711"
BR2_LINUX_KERNEL_DTS_SUPPORT=y
BR2_LINUX_KERNEL_INTREE_DTS_NAME="broadcom/bcm2837-rpi-zero-2-w"
BR2_LINUX_KERNEL_NEEDS_HOST_OPENSSL=y
BR2_LINUX_KERNEL_IMAGE_TARGET_CUSTOM=y
BR2_LINUX_KERNEL_IMAGE_TARGET_NAME="Image"

# ── RPi bootloader firmware ───────────────────────────────────────────────────
BR2_PACKAGE_RPI_FIRMWARE=y
# Pi Zero 2W shares the Pi 3 / BCM2710 firmware
BR2_PACKAGE_RPI_FIRMWARE_VARIANT_PI3_64=y

# ── Filesystem ────────────────────────────────────────────────────────────────
BR2_TARGET_ROOTFS_EXT2=y
BR2_TARGET_ROOTFS_EXT2_4=y
BR2_TARGET_ROOTFS_EXT2_SIZE="256M"

# ── Networking ────────────────────────────────────────────────────────────────
BR2_PACKAGE_DHCPCD=y
BR2_PACKAGE_WPA_SUPPLICANT=y
BR2_PACKAGE_WPA_SUPPLICANT_NL80211=y
BR2_PACKAGE_WPA_SUPPLICANT_CTRL_IFACE_DBUS=y
BR2_PACKAGE_IFUPDOWN_SCRIPTS=y
BR2_PACKAGE_IPROUTE2=y

# ── Bluetooth ─────────────────────────────────────────────────────────────────
BR2_PACKAGE_BLUEZ5_UTILS=y
BR2_PACKAGE_BLUEZ5_UTILS_CLIENT=y

# ── Bluetooth audio (A2DP sink via bluealsa) ──────────────────────────────────
BR2_PACKAGE_SBC=y
BR2_PACKAGE_BLUEZ_ALSA=y

# ── ALSA ─────────────────────────────────────────────────────────────────────
BR2_PACKAGE_ALSA_LIB=y
BR2_PACKAGE_ALSA_LIB_ALOAD=y
BR2_PACKAGE_ALSA_UTILS=y
BR2_PACKAGE_ALSA_UTILS_APLAY=y
BR2_PACKAGE_ALSA_UTILS_ARECORD=y

# ── mDNS (AriaCast device discovery) ─────────────────────────────────────────
BR2_PACKAGE_AVAHI=y
BR2_PACKAGE_LIBDAEMON=y

# ── SSH access ────────────────────────────────────────────────────────────────
BR2_PACKAGE_DROPBEAR=y

# ── BT agent — Python D-Bus ───────────────────────────────────────────────────
BR2_PACKAGE_PYTHON3=y
BR2_PACKAGE_PYTHON_DBUS=y
BR2_PACKAGE_PYTHON_PYGOBJECT=y

# ── Host tools ────────────────────────────────────────────────────────────────
BR2_PACKAGE_HOST_GENIMAGE=y
BR2_PACKAGE_HOST_DOSFSTOOLS=y
BR2_PACKAGE_HOST_MTOOLS=y

# ── Board hooks ───────────────────────────────────────────────────────────────
BR2_ROOTFS_POST_BUILD_SCRIPT="$(BR2_EXTERNAL_ARIACOMP_PATH)/board/post-build.sh"
BR2_ROOTFS_POST_IMAGE_SCRIPT="$(BR2_EXTERNAL_ARIACOMP_PATH)/board/post-image.sh"
BR2_ROOTFS_OVERLAY="$(BR2_EXTERNAL_ARIACOMP_PATH)/board/rootfs_overlay"
```
